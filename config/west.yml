## config/west.yml
```yaml
manifest:
  remotes:
    # zmk official
    - name: zmkfirmware
      url-base: https://github.com/zmkfirmware
    # bravekarma
    - name: caksoylar
      url-base: https://github.com/caksoylar
      # kyek / duckyb
    - name: duckyb
      url-base: https://github.com/duckyb
    # nice-view-gem
    - name: m165437
      url-base: https://github.com/M165437
    # Nice-View-Battery
    - name: infely
      url-base: https://github.com/infely
    # ZMK tri-state
    - name: dhruvinsh
      url-base: https://github.com/dhruvinsh
  projects:
    - name: zmk
      remote: zmkfirmware
      revision: main
      import: app/west.yml
    - name: urchin-zmk-module
      remote: duckyb
      revision: main
    - name: nice-view-gem
      remote: m165437
      revision: main
    - name: zmk-tri-state
      remote: dhruvinsh
      revision: main
    - name: nice-view-battery
      remote: infely
      revision: main
  self:
    path: config
```
